## config/boards/shields/TAKA/Kconfig.shield
```kconfig
# Copyright (c) 2022 The ZMK Contributors
# SPDX-License-Identifier: MIT

config SHIELD_TAKA_LEFT
    def_bool $(shields_list_contains,TAKA_left)

config SHIELD_TAKA_RIGHT
    def_bool $(shields_list_contains,TAKA_right)
```

## config/boards/shields/totem/Kconfig.defconfig
```kconfig
if SHIELD_TAKA_LEFT

config ZMK_KEYBOARD_NAME
    default "TAKA"
    
config ZMK_SPLIT_ROLE_CENTRAL
    default y

endif

if SHIELD_TAKA_LEFT || SHIELD_TAKA_RIGHT

config ZMK_SPLIT
    default y

endif
```
